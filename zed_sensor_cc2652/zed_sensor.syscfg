/**
 * @cliArgs --board "/ti/boards/CC26X2R1_LAUNCHXL" --product "simplelink_cc13x2_26x2_sdk@4.30.00.54"
 * @versions {"data":"2020090214","timestamp":"2020090214","tool":"1.6.0+1543","templates":"2020090214"}
 */

/**
 * Import the modules used in this configuration.
 */
const CCFG     = scripting.addModule("/ti/devices/CCFG");
const rfdesign = scripting.addModule("/ti/devices/radioconfig/rfdesign");
const ADC      = scripting.addModule("/ti/drivers/ADC", {}, false);
const ADC1     = ADC.addInstance();
const AESCBC   = scripting.addModule("/ti/drivers/AESCBC");
const AESCBC1  = AESCBC.addInstance();
const AESCCM   = scripting.addModule("/ti/drivers/AESCCM");
const AESCCM1  = AESCCM.addInstance();
const AESECB   = scripting.addModule("/ti/drivers/AESECB");
const AESECB1  = AESECB.addInstance();
const DMA      = scripting.addModule("/ti/drivers/DMA");
const ECDH     = scripting.addModule("/ti/drivers/ECDH");
const ECDH1    = ECDH.addInstance();
const ECDSA    = scripting.addModule("/ti/drivers/ECDSA");
const ECDSA1   = ECDSA.addInstance();
const ECJPAKE  = scripting.addModule("/ti/drivers/ECJPAKE");
const ECJPAKE1 = ECJPAKE.addInstance();
const NVS      = scripting.addModule("/ti/drivers/NVS");
const NVS1     = NVS.addInstance();
const NVS2     = NVS.addInstance();
const Power    = scripting.addModule("/ti/drivers/Power");
const RF       = scripting.addModule("/ti/drivers/RF");
const SHA2     = scripting.addModule("/ti/drivers/SHA2");
const SHA21    = SHA2.addInstance();
const TRNG     = scripting.addModule("/ti/drivers/TRNG");
const TRNG1    = TRNG.addInstance();
const UART     = scripting.addModule("/ti/drivers/UART");
const UART1    = UART.addInstance();
const Button   = scripting.addModule("/ti/drivers/apps/Button");
const Button1  = Button.addInstance();
const Button2  = Button.addInstance();
const LED      = scripting.addModule("/ti/drivers/apps/LED");
const LED1     = LED.addInstance();
const LED2     = LED.addInstance();
const zstack   = scripting.addModule("/ti/zstack/zstack");

/**
 * Write custom configuration values to the imported modules.
 */
CCFG.enableBootloader         = true;
CCFG.enableBootloaderBackdoor = true;
CCFG.dioBootloaderBackdoor    = 13;
CCFG.levelBootloaderBackdoor  = "Active low";
CCFG.ccfgTemplate.$name       = "ti_devices_CCFGTemplate0";

ADC1.$name          = "CONFIG_ADC_0";
ADC1.internalSignal = "Battery Channel";

AESCBC1.$name = "CONFIG_AESCBC_0";

AESCCM1.$name             = "CONFIG_AESCCM_0";
AESCCM1.interruptPriority = "2";

AESECB1.$name             = "CONFIG_AESECB_0";
AESECB1.interruptPriority = "1";

ECDH1.$name = "CONFIG_ECDH_0";

ECDSA1.$name = "CONFIG_ECDSA_0";

ECJPAKE1.$name = "CONFIG_ECJPAKE_0";

NVS1.$name                    = "CONFIG_NVSINTERNAL";
NVS1.internalFlash.$name      = "ti_drivers_nvs_NVSCC26XX0";
NVS1.internalFlash.regionBase = 0x52000;
NVS1.internalFlash.regionSize = 0x4000;

NVS2.$name                          = "CONFIG_NVSEXTERNAL";
NVS2.nvsType                        = "External";
NVS2.$hardware                      = system.deviceData.board.components.MX25R8035F;
NVS2.externalFlash.$name            = "ti_drivers_nvs_NVSSPI25X0";
NVS2.externalFlash.regionSize       = 0x256000;
NVS2.externalFlash.verifyBufferSize = 64;

SHA21.$name = "CONFIG_SHA2_0";

TRNG1.$name = "CONFIG_TRNG_0";

UART1.$hardware           = system.deviceData.board.components.XDS110UART;
UART1.$name               = "CONFIG_DISPLAY_UART";
UART1.txPinInstance.$name = "CONFIG_PIN_UART_TX";
UART1.rxPinInstance.$name = "CONFIG_PIN_UART_RX";

Button1.$name                     = "CONFIG_BTN_LEFT";
Button1.$hardware                 = system.deviceData.board.components["BTN-1"];
Button1.gpioPin.$name             = "CONFIG_GPIO_BTN1";
Button1.gpioPin.pinInstance.$name = "CONFIG_PIN_BTN1";

Button2.$name                     = "CONFIG_BTN_RIGHT";
Button2.$hardware                 = system.deviceData.board.components["BTN-2"];
Button2.gpioPin.$name             = "CONFIG_GPIO_BTN2";
Button2.gpioPin.pinInstance.$name = "CONFIG_PIN_BTN2";

LED1.$name                     = "CONFIG_LED_RED";
LED1.$hardware                 = system.deviceData.board.components.LED_RED;
LED1.gpioPin.$name             = "CONFIG_GPIO_RLED";
LED1.gpioPin.pinInstance.$name = "CONFIG_PIN_RLED";

LED2.$name                     = "CONFIG_LED_GREEN";
LED2.$hardware                 = system.deviceData.board.components.LED_GREEN;
LED2.gpioPin.$name             = "CONFIG_GPIO_GLED";
LED2.gpioPin.pinInstance.$name = "CONFIG_PIN_GLED";

const NVSSPI25XDevice                                      = scripting.addModule("/ti/drivers/nvs/NVSSPI25XDevice", {}, false);
const NVSSPI25XDevice1                                     = NVSSPI25XDevice.addInstance({}, false);
NVSSPI25XDevice1.$name                                     = "CONFIG_NVS_SPI_0";
NVS2.externalFlash.spiFlashDevice                          = NVSSPI25XDevice1;
NVSSPI25XDevice1.slaveSelectGpioInstance.$name             = "CONFIG_GPIO_0";
NVSSPI25XDevice1.slaveSelectGpioInstance.pinInstance.$name = "CONFIG_PIN_0";

const SPI                          = scripting.addModule("/ti/drivers/SPI", {}, false);
const SPI1                         = SPI.addInstance({}, false);
SPI1.$name                         = "CONFIG_SPI_0";
NVSSPI25XDevice1.sharedSpiInstance = SPI1;
SPI1.sclkPinInstance.$name         = "CONFIG_PIN_SPI_SCLK";
SPI1.misoPinInstance.$name         = "CONFIG_PIN_SPI_MISO";
SPI1.mosiPinInstance.$name         = "CONFIG_PIN_SPI_MOSI";

zstack.deviceType                            = "zed";
zstack.deviceTypeReadOnly                    = true;
zstack.touchlink.$name                       = "ti_zstack_touchlink_zstack_touchlink0";
zstack.pm.$name                              = "ti_zstack_pm_zstack_pm0";
zstack.rf.$name                              = "ti_zstack_rf_zstack_rf0";
zstack.rf.radioConfig.$name                  = "ti_devices_radioconfig_settings_ieee_15_40";
zstack.rf.radioConfig.codeExportConfig.$name = "ti_devices_radioconfig_code_export_param0";
zstack.network.$name                         = "ti_zstack_network_zstack_network0";
zstack.advanced.$name                        = "ti_zstack_advanced_zstack_advanced0";
zstack.advanced.routing.$name                = "ti_zstack_advanced_zstack_routing0";
zstack.advanced.packetSending.$name          = "ti_zstack_advanced_zstack_packet_sending0";
zstack.advanced.tableSize.$name              = "ti_zstack_advanced_zstack_table_size0";

/**
 * Pinmux solution for unlocked pins/peripherals. This ensures that minor changes to the automatic solver in a future
 * version of the tool will not impact the pinmux you originally saw.  These lines can be completely deleted in order to
 * re-solve from scratch.
 */
UART1.uart.$suggestSolution                                       = "UART1";
UART1.uart.txPin.$suggestSolution                                 = "boosterpack.4";
UART1.uart.rxPin.$suggestSolution                                 = "boosterpack.3";
Button1.gpioPin.gpioPin.$suggestSolution                          = "boosterpack.13";
Button2.gpioPin.gpioPin.$suggestSolution                          = "boosterpack.12";
LED1.gpioPin.gpioPin.$suggestSolution                             = "boosterpack.39";
LED2.gpioPin.gpioPin.$suggestSolution                             = "boosterpack.40";
NVSSPI25XDevice1.slaveSelectGpioInstance.gpioPin.$suggestSolution = "boosterpack.38";
SPI1.spi.$suggestSolution                                         = "SSI0";
SPI1.spi.sclkPin.$suggestSolution                                 = "boosterpack.7";
SPI1.spi.misoPin.$suggestSolution                                 = "boosterpack.14";
SPI1.spi.mosiPin.$suggestSolution                                 = "boosterpack.15";
SPI1.spi.dmaRxChannel.$suggestSolution                            = "DMA_CH3";
SPI1.spi.dmaTxChannel.$suggestSolution                            = "DMA_CH4";
